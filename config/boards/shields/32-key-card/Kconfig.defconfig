## config/boards/shields/32-key-card/Kconfig.defconfig
```kconfig
if 32_KEY_CARD_LEFT

config ZMK_KEYBOARD_NAME
    default "card"

config ZMK_SPLIT_ROLE_CENTRAL
    default y

endif


if 32_KEY_CARD_LEFT || 32_KEY_CARD_RIGHT

config ZMK_SPLIT
    default y

endif

# if 32_KEY_CARD_RIGHT

# config ZMK_KEYBOARD_NAME
#     default "The Card Right"

# config ZMK_SPLIT_ROLE_CENTRAL
#     default n

# endif
```

## config/boards/shields/32-key-card/Kconfig.shield
```kconfig
config 32_KEY_CARD_LEFT
    def_bool $(shields_list_contains,32_key_card_left)

config 32_KEY_CARD_RIGHT
    def_bool $(shields_list_contains,32_key_card_right)
```

## config/boards/shields/bonnie_cradio/Kconfig.shield
```kconfig
# Copyright (c) 2020 The ZMK Contributors
# SPDX-License-Identifier: MIT

config BONNIE_SHIELD_CRADIO_LEFT
	def_bool $(shields_list_contains,bonnie_cradio_left)

config BONNIE_SHIELD_CRADIO_RIGHT
	def_bool $(shields_list_contains,bonnie_cradio_right)
```
